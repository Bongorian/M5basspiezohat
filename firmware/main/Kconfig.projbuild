## firmware/main/Kconfig.projbuild
```kconfig
menu "M5basspiezohat"
    config BASS_FAST_TRACKING
        bool "Short startup observation and 4 ms initial pitch update"
        default y
        help
            Start with a shorter YIN comparison window and 4 ms updates.
            Sustained notes use the longer window and 8 ms updates.
            Disable to use the longer window and 8 ms updates from startup.
            Both modes retain two stable decisions and the confidence gate.
            Shorter observations must be evaluated with the actual instrument.
    config BASS_STRING_COUNT
        int "Number of strings (J1 upwards: B E A D G, or E A D G)"
        range 4 5
        default 5
    config BASS_SLOT_J1
        int "TDM slot for J1"
        range 0 7
        default 0
    config BASS_SLOT_J2
        int "TDM slot for J2"
        range 0 7
        default 1
    config BASS_SLOT_J3
        int "TDM slot for J3"
        range 0 7
        default 2
    config BASS_SLOT_J4
        int "TDM slot for J4"
        range 0 7
        default 3
    config BASS_SLOT_J5
        int "TDM slot for J5"
        range 0 7
        default 4
    config BASS_GATE_ON_MILLI
        int "Note-on RMS threshold in thousandths of full scale"
        range 1 200
        default 4
    config BASS_GATE_OFF_MILLI
        int "Note-off RMS threshold in thousandths of full scale"
        range 1 199
        default 2
    config BASS_GAIN_DB
        int "ADC PGA gain, dB (rounded down to steps of 3 dB)"
        range 0 30
        default 0
    config BASS_MIDI_CHANNEL
        int "MIDI output channel (base channel when strings are separate)"
        range 1 16
        default 1
    config BASS_PER_STRING_CHANNELS
        bool "Separate MIDI channel for each string"
        default n
        help
            When disabled, all strings share one channel. Identical notes are held
            until the last owning string releases them. When enabled, the base
            channel plus the string count must not exceed MIDI channel 16.
    config BASS_PITCH_BEND
        bool "Per-string pitch bend (range +/-2 semitones)"
        depends on BASS_PER_STRING_CHANNELS
        default n
    config BASS_START_MUTED
        bool "Start muted until input slot mapping is checked"
        default y
    choice BASS_TDM_FORMAT
        prompt "TDM format for cascade evaluation"
        default BASS_TDM_DSP_A
        config BASS_TDM_DSP_A
            bool "DSP A (one BCLK pulse, sequential channel slots)"
        config BASS_TDM_PHILIPS
            bool "Philips (half-frame WS, odd/even channel grouping)"
    endchoice
endmenu
```

## firmware/sdkconfig.defaults
```kconfig
CONFIG_IDF_TARGET="esp32s3"
CONFIG_ESP_DEFAULT_CPU_FREQ_MHZ_240=y
CONFIG_ESPTOOLPY_FLASHSIZE_8MB=y
CONFIG_PARTITION_TABLE_CUSTOM=y
CONFIG_PARTITION_TABLE_CUSTOM_FILENAME="partitions.csv"
CONFIG_SPIRAM=y
CONFIG_SPIRAM_MODE_OCT=y
CONFIG_SPIRAM_SPEED_80M=y
CONFIG_SPIRAM_USE_MALLOC=y
CONFIG_FREERTOS_HZ=1000
CONFIG_COMPILER_OPTIMIZATION_PERF=y
CONFIG_TINYUSB_MIDI_COUNT=1
CONFIG_TINYUSB_CDC_ENABLED=y
CONFIG_TINYUSB_CDC_COUNT=1
CONFIG_TINYUSB_CDC_RX_BUFSIZE=256
CONFIG_TINYUSB_CDC_TX_BUFSIZE=1024
CONFIG_ESP_CONSOLE_UART_DEFAULT=y
CONFIG_ESP_MAIN_TASK_STACK_SIZE=8192
CONFIG_ESP_TASK_WDT_PANIC=y
CONFIG_FREERTOS_USE_TRACE_FACILITY=y
CONFIG_FREERTOS_GENERATE_RUN_TIME_STATS=y
```
